## meta-rugix-core/conf/layer.conf
```bitbake
BBPATH .= ":${LAYERDIR}"

BBFILES += "${LAYERDIR}/recipes-*/*/*.bb \
            ${LAYERDIR}/recipes-*/*/*.bbappend"

BBFILE_COLLECTIONS += "meta-rugix-core"
BBFILE_PATTERN_meta-rugix-core = "^${LAYERDIR}/"
BBFILE_PRIORITY_meta-rugix-core = "6"

LAYERDEPENDS_meta-rugix-core = "core openembedded-layer"
LAYERRECOMMENDS_meta-rugix-core = ""
LAYERSERIES_COMPAT_meta-rugix-core = "wrynose"

RUGIX_FEATURES ?= ""

IMAGE_CLASSES += "rugix-deploy-partitions image-type-rugixb rugix-features"
IMAGE_INSTALL:append = "${@bb.utils.contains('DISTRO_FEATURES', 'rugix', ' packagegroup-rugix', '', d)}"
```
