## meta-rugix-nxp-imx-uboot/conf/layer.conf
```bitbake
BBPATH .= ":${LAYERDIR}"

BBFILES += "${LAYERDIR}/recipes-*/*/*.bb \
            ${LAYERDIR}/recipes-*/*/*.bbappend"

BBFILE_COLLECTIONS += "meta-rugix-nxp-imx-uboot"
BBFILE_PATTERN_meta-rugix-nxp-imx-uboot = "^${LAYERDIR}/"
BBFILE_PRIORITY_meta-rugix-nxp-imx-uboot = "10"

LAYERDEPENDS_meta-rugix-nxp-imx-uboot = "core meta-rugix-core freescale-layer"
LAYERSERIES_COMPAT_meta-rugix-nxp-imx-uboot = "scarthgap"

WKS_FILE:imx-nxp-bsp ?= "sdimage-rugix-nxp-imx-uboot.wks.in"
WKS_FILE_DEPENDS:append:imx-nxp-bsp = " imx-boot virtual/bootloader rugix-bootstrap-marker rugix-boot-script"
RUGIX_SLOTS:imx-nxp-bsp ?= "boot:file:${IMGDEPLOYDIR}/${IMAGE_LINK_NAME}.boot.img system:file:${IMGDEPLOYDIR}/${IMAGE_LINK_NAME}.ext4.verity"

# Size of the per-slot boot partition reserved in the partition table and via
# bootstrapping. The actual FAT image that fit-boot-img.bbclass produces is
# sized to fit the current FIT; the partition just needs to be at least that
# large.
RUGIX_BOOT_SIZE:imx-nxp-bsp ?= "96MiB"
IMAGE_INSTALL:append:imx-nxp-bsp = "${@bb.utils.contains('DISTRO_FEATURES', 'rugix', ' packagegroup-rugix-bsp', '', d)}"

# Build the kernel as a FIT image (kernel + DTBs + initramfs). Rugix then
# post-processes the FIT at image time to stamp in the slot's dm-verity root
# hash via fit-boot-img.bbclass.
KERNEL_CLASSES:append:imx-nxp-bsp = "${@bb.utils.contains('DISTRO_FEATURES', 'rugix', ' kernel-fitimage', '', d)}"
KERNEL_IMAGETYPES:imx-nxp-bsp = "${@bb.utils.contains('DISTRO_FEATURES', 'rugix', 'fitImage', 'Image', d)}"
INITRAMFS_IMAGE:imx-nxp-bsp ?= "${@bb.utils.contains('DISTRO_FEATURES', 'rugix', 'verity-initramfs', '', d)}"
INITRAMFS_IMAGE_BUNDLE:imx-nxp-bsp ?= "0"

# Reserve padding in the FIT so fit-boot-img.bbclass can inject the bootargs
# property at image time without having to reassemble the FIT.
UBOOT_MKIMAGE_DTCOPTS:imx-nxp-bsp ?= "-I dts -O dtb -p 2000"

IMAGE_CLASSES:append:imx-nxp-bsp = "${@bb.utils.contains('DISTRO_FEATURES', 'rugix', ' image_types_verity fit-boot-img', '', d)}"

# NXP's imx-base.inc does not set UBOOT_ENTRYPOINT for i.MX9.
UBOOT_ENTRYPOINT:mx9-nxp-bsp ?= "0x80400000"
UBOOT_LOADADDRESS:mx9-nxp-bsp ?= "0x80400000"

# FDT load address for FIT extraction. Must differ from the FIT staging address
# so U-Boot doesn't expand the DTB over the ramdisk in the FIT.
UBOOT_DTB_LOADADDRESS:mx9-nxp-bsp ?= "0x83000000"

IMAGE_FSTYPES:append:imx-nxp-bsp = "${@bb.utils.contains('DISTRO_FEATURES', 'rugix', ' ext4 verity', '', d)}"
EXTRA_IMAGECMD:ext4:append:imx-nxp-bsp = "${@bb.utils.contains('DISTRO_FEATURES', 'rugix', ' -b 4096 -O ^has_journal', '', d)}"

# Rugix owns the FAT config partition. Override (not append) IMAGE_BOOT_FILES
# so NXP-default kernel/dtb do NOT end up there. Only the boot script and
# bootstrap marker live on the config partition; the A/B FITs live in their own
# per-slot FAT images built by fit-boot-img.bbclass.
IMAGE_BOOT_FILES:imx-nxp-bsp = "boot.scr rugix-bootstrap;rugix/bootstrap"
```

## meta-rugix-qemu-arm64-uboot/conf/layer.conf
```bitbake
BBPATH .= ":${LAYERDIR}"

BBFILES += "${LAYERDIR}/recipes-*/*/*.bb \
            ${LAYERDIR}/recipes-*/*/*.bbappend"

BBFILE_COLLECTIONS += "meta-rugix-qemu-arm64-uboot"
BBFILE_PATTERN_meta-rugix-qemu-arm64-uboot = "^${LAYERDIR}/"
BBFILE_PRIORITY_meta-rugix-qemu-arm64-uboot = "10"

LAYERDEPENDS_meta-rugix-qemu-arm64-uboot = "core meta-rugix-core"
LAYERRECOMMENDS_meta-rugix-qemu-arm64-uboot = "lts-u-boot-mixin"
LAYERSERIES_COMPAT_meta-rugix-qemu-arm64-uboot = "scarthgap"

WKS_FILE:qemuarm64 ?= "qemu-arm64-rugix-uboot.wks"
WKS_FILE_DEPENDS:append:qemuarm64 = " u-boot-boot-image"
RUGIX_SLOTS:qemuarm64 ?= "system:2"
IMAGE_INSTALL:append:qemuarm64 = "${@bb.utils.contains('DISTRO_FEATURES', 'rugix', ' packagegroup-rugix-bsp', '', d)}"
```

## meta-rugix-qemu-arm64-uboot/wic/qemu-arm64-rugix-uboot.wks
```
# Rugix A/B partition layout for QEMU ARM64 with U-Boot.
#
# Partition 1: Boot partition (U-Boot boot script, Rugix config partition)
# Partition 2: System A (rootfs, booted by default)
#
# Bootstrapping expands the table on first boot.

bootloader --ptable gpt

part --source rawcopy --sourceparams="file=uboot-boot.vfat" --ondisk vda --label boot --align 4096 --fixed-size 64M --part-type EBD0A0A2-B9E5-4433-87C0-68B6B72699C7
part / --source rootfs --ondisk vda --label system-a --fstype=ext4 --align 4096 --mkfs-extraopts "-O ^has_journal"
```

## meta-rugix-qemu-x86_64-grub/conf/layer.conf
```bitbake
BBPATH .= ":${LAYERDIR}"

BBFILES += "${LAYERDIR}/recipes-*/*/*.bb \
            ${LAYERDIR}/recipes-*/*/*.bbappend"

BBFILE_COLLECTIONS += "meta-rugix-qemu-x86_64-grub"
BBFILE_PATTERN_meta-rugix-qemu-x86_64-grub = "^${LAYERDIR}/"
BBFILE_PRIORITY_meta-rugix-qemu-x86_64-grub = "10"

LAYERDEPENDS_meta-rugix-qemu-x86_64-grub = "core meta-rugix-core"
LAYERSERIES_COMPAT_meta-rugix-qemu-x86_64-grub = "scarthgap"

WKS_FILE:qemux86-64 ?= "qemu-x86_64-rugix-grub-efi.wks"
WKS_FILE_DEPENDS:append:qemux86-64 = " efi-boot-image"
RUGIX_SLOTS:qemux86-64 ?= "system:2"
IMAGE_INSTALL:append:qemux86-64 = "${@bb.utils.contains('DISTRO_FEATURES', 'rugix', ' packagegroup-rugix-bsp', '', d)}"
```

## meta-rugix-qemu-x86_64-grub/wic/qemu-x86_64-rugix-grub-efi.wks
```
# Rugix A/B partition layout for QEMU x86_64 with GRUB EFI.
#
# Partition 1: EFI System Partition (Rugix config partition)
# Partition 2: System A (rootfs, booted by default)
#
# Bootstrapping expands the table on first boot to add System B and Data
# partitions per bootstrapping.toml.

bootloader --ptable gpt

part --source rawcopy --sourceparams="file=efi-boot.vfat" --ondisk sda --label EFI --align 4096 --fixed-size 64M --part-type C12A7328-F81F-11D2-BA4B-00A0C93EC93B
part / --source rootfs --ondisk sda --label system-a --fstype=ext4 --align 4096 --mkfs-extraopts "-O ^has_journal"
```

## meta-rugix-rpi-tryboot/conf/layer.conf
```bitbake
BBPATH .= ":${LAYERDIR}"

BBFILES += "${LAYERDIR}/recipes-*/*/*.bb \
            ${LAYERDIR}/recipes-*/*/*.bbappend"

BBFILE_COLLECTIONS += "meta-rugix-rpi-tryboot"
BBFILE_PATTERN_meta-rugix-rpi-tryboot = "^${LAYERDIR}/"
BBFILE_PRIORITY_meta-rugix-rpi-tryboot = "10"

LAYERDEPENDS_meta-rugix-rpi-tryboot = "core meta-rugix-core"
LAYERRECOMMENDS_meta-rugix-rpi-tryboot = ""
LAYERSERIES_COMPAT_meta-rugix-rpi-tryboot = "kirkstone scarthgap"

RUGIX_WKS_FILE:rpi ?= "sdimage-rugix-rpi-tryboot.wks.in"
RUGIX_SLOTS:rpi ?= "boot:2 system:4"
```

## meta-rugix-rpi-uboot/conf/layer.conf
```bitbake
BBPATH .= ":${LAYERDIR}"

BBFILES += "${LAYERDIR}/recipes-*/*/*.bb \
            ${LAYERDIR}/recipes-*/*/*.bbappend"

BBFILE_COLLECTIONS += "meta-rugix-rpi-uboot"
BBFILE_PATTERN_meta-rugix-rpi-uboot = "^${LAYERDIR}/"
# We need to overwrite parts of what `meta-raspberrypi` is doing.
BBFILE_PRIORITY_meta-rugix-rpi-uboot = "10"

LAYERDEPENDS_meta-rugix-rpi-uboot = "core meta-rugix-core"
LAYERRECOMMENDS_meta-rugix-rpi-uboot = "lts-u-boot-mixin"
LAYERSERIES_COMPAT_meta-rugix-rpi-uboot = "kirkstone scarthgap"

RUGIX_WKS_FILE:rpi ?= "sdimage-rugix-rpi-uboot.wks.in"
RUGIX_SLOTS:rpi ?= "system:2"
```
